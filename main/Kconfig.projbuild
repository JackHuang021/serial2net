## main/Kconfig.projbuild
```kconfig
menu "Serial2Net Configuration"

    menu "WiFi Settings"
        choice SERIAL2NET_WIFI_MODE
            prompt "WiFi Mode"
            default SERIAL2NET_WIFI_MODE_STA_AP_FALLBACK
            help
                Select the WiFi operation mode.

            config SERIAL2NET_WIFI_MODE_STA
                bool "Station (connect to router)"
            config SERIAL2NET_WIFI_MODE_AP
                bool "Access Point (ESP32 creates hotspot)"
            config SERIAL2NET_WIFI_MODE_STA_AP_FALLBACK
                bool "Station + AP fallback (try STA first, fallback to AP)"
        endchoice

        config SERIAL2NET_WIFI_STA_SSID
            string "Station SSID (factory default)"
            default "myssid"
            help
                Factory-default WiFi SSID for Station mode.
                When credentials are saved via the web UI, they override
                this value and persist across reboots in NVS.
                Erase NVS flash to restore this factory default.

        config SERIAL2NET_WIFI_STA_PASSWORD
            string "Station Password (factory default)"
            default "mypassword"
            help
                Factory-default WiFi password for Station mode.
                When credentials are saved via the web UI, they override
                this value and persist across reboots in NVS.
                Erase NVS flash to restore this factory default.

        config SERIAL2NET_WIFI_STA_MAX_RETRY
            int "Station max retry count"
            default 5
            range 1 30
            help
                Maximum number of connection retries before giving up
                (only used in STA+AP fallback mode).

        config SERIAL2NET_WIFI_AP_SSID
            string "AP SSID"
            default "serial2net"
            help
                SSID for Access Point mode (MAC address suffix auto-appended).

        config SERIAL2NET_WIFI_AP_PASSWORD
            string "AP Password"
            default "12345678"
            help
                Password for the Access Point (min 8 characters).
    endmenu

    menu "UART Settings"
        config SERIAL2NET_UART_PORT
            int "UART Port Number"
            default 2
            range 0 2
            help
                UART port number. UART0 is usually reserved for console.
                UART1 and UART2 are available for peripheral connections.

        config SERIAL2NET_UART_BAUD
            int "Baud Rate"
            default 115200
            range 1200 4000000
            help
                UART baud rate for communication with the target device.

        config SERIAL2NET_UART_TX_PIN
            int "TX GPIO Pin"
            default 17 if IDF_TARGET_ESP32S3
            default 6 if IDF_TARGET_ESP32C3
            default 17 if IDF_TARGET_ESP32
            default 1
            help
                GPIO pin for UART TX (connect to target device RX).

        config SERIAL2NET_UART_RX_PIN
            int "RX GPIO Pin"
            default 16 if IDF_TARGET_ESP32S3
            default 7 if IDF_TARGET_ESP32C3
            default 16 if IDF_TARGET_ESP32
            default 3
            help
                GPIO pin for UART RX (connect to target device TX).

        config SERIAL2NET_UART_BUFFER_SIZE
            int "UART RX Buffer Size"
            default 2048
            range 256 8192
            help
                Size of the UART RX ring buffer in bytes.
    endmenu

    menu "LED Settings"
        config SERIAL2NET_LED_ENABLE
            bool "Enable WS2812B RGB LED"
            default y
            help
                Enable WS2812B/Neopixel RGB LED for status indication.

        config SERIAL2NET_LED_PIN
            int "WS2812B Data Pin"
            default 48 if IDF_TARGET_ESP32S3
            default 8 if IDF_TARGET_ESP32C3
            default 18 if IDF_TARGET_ESP32
            default 8
            help
                GPIO pin connected to the WS2812B data input.
                ESP32-S3 default GPIO48 (common on dev boards).
    endmenu

    menu "TCP Settings"
        config SERIAL2NET_TCP_PORT
            int "TCP Listen Port"
            default 8880
            range 1024 65535
            help
                TCP port the server listens on for incoming connections.
    endmenu

    menu "Telnet Settings"
        config SERIAL2NET_TELNET_ENABLE
            bool "Enable Telnet protocol (RFC 854)"
            default y
            help
                Enable Telnet server (RFC 854 + RFC 856 Binary Transmission)
                on a separate port. Allows standard telnet clients to connect
                without any special raw-mode configuration:
                    telnet serial2net.local

                When disabled, only the raw TCP bridge is available.

        config SERIAL2NET_TELNET_PORT
            int "Telnet TCP Port"
            default 23
            range 1 65535
            depends on SERIAL2NET_TELNET_ENABLE
            help
                TCP port for the Telnet (RFC 854) server.
                Standard telnet port is 23; use a higher port if running
                without root privileges on the client side:
                    telnet serial2net.local 8023

        config SERIAL2NET_TELNET_NEGOTIATION_TIMEOUT_MS
            int "Telnet negotiation timeout (ms)"
            default 3000
            range 500 30000
            depends on SERIAL2NET_TELNET_ENABLE
            help
                Close the Telnet connection if binary transmission mode
                is not negotiated within this time. Modern telnet clients
                complete negotiation within milliseconds.
    endmenu

    menu "HTTP Configuration Server"
        config SERIAL2NET_HTTP_CONFIG_ENABLE
            bool "Enable on-demand WiFi config portal"
            default y
            help
                When STA fails to connect at boot, or when the BOOT
                button is held down, the device starts an AP with a
                web-based WiFi configuration interface (port 80).

                The portal provides scan, select, and connect
                functionality and stops automatically once a WiFi
                connection is established. Connect to the AP:
                  SSID:     serial2net
                  Password: 12345678
                  URL:      http://192.168.4.1/

                If disabled, WiFi credentials can only be set via
                Kconfig at compile time.

        config SERIAL2NET_BOOT_BUTTON_PIN
            int "BOOT Button GPIO"
            default 0 if IDF_TARGET_ESP32S3
            default 0 if IDF_TARGET_ESP32C3
            default 0
            depends on SERIAL2NET_HTTP_CONFIG_ENABLE
            help
                GPIO pin connected to the BOOT button (active low,
                internal pull-up enabled).  Hold for ≥400 ms to
                enter the WiFi configuration portal manually.

    endmenu

    menu "OTA Firmware Update"
        config SERIAL2NET_OTA_ENABLE
            bool "Enable OTA firmware update"
            default y
            help
                Enables over-the-air firmware updates via the Web UI
                (POST /api/ota). Firmware is written to the inactive
                OTA partition and the device reboots automatically.

                Requires a partition scheme with OTA slots
                (e.g. custom partitions.csv with factory + ota_0 + ota_1).
    endmenu

endmenu
```
